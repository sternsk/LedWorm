## sdkconfig.defaults
```kconfig
CONFIG_ESPTOOLPY_FLASHSIZE_16MB=y

#CONFIG_LOG_DEFAULT_LEVEL_DEBUG=y
CONFIG_LOG_DEFAULT_LEVEL=3

CONFIG_HTTPD_WS_SUPPORT=y

# USB Serial/JTAG als primäre Console
CONFIG_ESP_CONSOLE_USB_SERIAL_JTAG=y

# Secondary Console optional deaktivieren
CONFIG_ESP_CONSOLE_SECONDARY_NONE=y

CONFIG_HTTPD_WS_SUPPORT=y
CONFIG_HTTPD_WS_POST_HANDSHAKE_CB_SUPPORT=y
```
